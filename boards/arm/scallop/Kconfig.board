## boards/arm/scallop/Kconfig.board
```kconfig
# Copyright (c) 2021 Nick Winans
# SPDX-License-Identifier: MIT

config BOARD_SCALLOP
	bool "Scallop"
	depends on SOC_NRF52840_QIAA
```

## boards/arm/scallop/Kconfig.defconfig
```kconfig
# Copyright (c) 2021 Nick Winans
# SPDX-License-Identifier: MIT
if BOARD_SCALLOP
config ZMK_KEYBOARD_NAME
    default "Scallop"

config BT_CTLR
    default BT

endif # BOARD_SCALLOP
```
